## drivers/slipmux_dev/Kconfig
```kconfig
/*
 * SPDX-FileCopyrightText: 2025 HAW Hamburg
 * SPDX-License-Identifier: LGPL-2.1-only
 */

menu "SLIPMUX driver"
    depends on USEMODULE_SLIPMUX_DEV

    config SLIPMUX_COAP_BUFSIZE
        depends on USEMODULE_SLIPMUX_COAP
        int "CoAP TX/RX buffer size, in bytes"
        range 0 9999999
        default 512
        help
            Size of the CoAP request / response buffer

    config SLIPMUX_NET_BUFSIZE
        depends on USEMODULE_SLIPMUX_NET
        int "IP packet TX/RX buffer size, in bytes"
        range 0 9999999
        default 2048
        help
            Size of the IP network interface TX/RX buffer. Reduce this value if your expected traffic does not include full IPv6 MTU sized packets.

endmenu # SLIPMUX driver
```

## pkg/stsafea/Kconfig
```kconfig
# Copyright (c) 2022 Teufelchen1
#
# This file is subject to the terms and conditions of the GNU Lesser
# General Public License v2.1. See the file LICENSE in the top level
# directory for more details.

menuconfig KCONFIG_USEPKG_STSAFEA
    bool "Configure STSAFE-A1xx Middleware"
    help
        Configure STSAFE-A1xx Middleware using Kconfig.

if KCONFIG_USEPKG_STSAFEA

choice
    prompt "Select the target device"

config STSAFE_A110
        bool "Build for the A110 device"

config STSAFE_A100
        bool "Build for the A100 device"

endchoice

config STSAFEA_I2C_NUM
    int "Select the I2C device number to which the unit is connected."
    default 0

endif # KCONFIG_USEPKG_STSAFEA
```

## sys/cborshell/cmds/Kconfig
```kconfig
# Copyright (c) 2022 Otto-von-Guericke-Universität Magdeburg
#
# This file is subject to the terms and conditions of the GNU Lesser
# General Public License v2.1. See the file LICENSE in the top level
# directory for more details.
#

menuconfig MODULE_SHELL_CMDS
    bool "Support for shell commands"
    depends on MODULE_SHELL

config CONFIG_MODULE_SHELL_COMMANDS
    bool
    select MODULE_SHELL_CMDS_DEFAULT
    help
        Deprecated alias for MODULE_SHELL_CMDS_DEFAULT. For new apps, use
        MODULE_SHELL_CMDS_DEFAULT directly.

config MODULE_SHELL_CMDS_DEFAULT
    bool "Default shell commands for enabled modules"
    select MODULE_SHELL_CMDS
    help
        Shell commands can be enabled and disabled individually as dedicated
        modules. This module instead will select the shell commands of modules
        already used, if this is considered as "good default choice".
```

## sys/mprotect/Kconfig
```kconfig
# Copyright (c) 2023 HAW Hamburg
#
# This file is subject to the terms and conditions of the GNU Lesser
# General Public License v2.1. See the file LICENSE in the top level
# directory for more details.
#

config MODULE_MPROTECT
    bool "Memory protection utilities"
    depends on TEST_KCONFIG
```
